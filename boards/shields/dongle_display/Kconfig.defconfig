## boards/shields/dongle_display/Kconfig.defconfig
```kconfig
# Copyright (c) 2024 The ZMK Contributors
# SPDX-License-Identifier: MIT

if SHIELD_DONGLE_DISPLAY

choice ZMK_DISPLAY_STATUS_SCREEN
    default ZMK_DISPLAY_STATUS_SCREEN_CUSTOM
endchoice

config ZMK_DISPLAY_STATUS_SCREEN_CUSTOM
    select LV_USE_LABEL
    select LV_USE_MATRIX if ZMK_DONGLE_DISPLAY_VERTICAL_BATTERY
    select LV_DRAW_TRANSFORM_USE_MATRIX if ZMK_DONGLE_DISPLAY_VERTICAL_BATTERY
    select LV_USE_IMAGE if !ZMK_DONGLE_DISPLAY_BATTERY_ONLY
    select LV_USE_CANVAS if !ZMK_DONGLE_DISPLAY_BATTERY_ONLY
    select LV_USE_ANIMIMG if !ZMK_DONGLE_DISPLAY_BATTERY_ONLY
    select LV_USE_ANIMATION if !ZMK_DONGLE_DISPLAY_BATTERY_ONLY
    select LV_USE_LINE if !ZMK_DONGLE_DISPLAY_BATTERY_ONLY
    select LV_FONT_UNSCII_8
    select ZMK_WPM if !ZMK_DONGLE_DISPLAY_BATTERY_ONLY
    imply ZMK_HID_INDICATORS if !ZMK_DONGLE_DISPLAY_BATTERY_ONLY

config ZMK_DONGLE_DISPLAY_BATTERY_ONLY
    bool "Use a minimal battery-only status screen"
    help
        Replace the default dongle-display screen with a lightweight
        label-only battery view.

config ZMK_DONGLE_DISPLAY_VERTICAL_BATTERY
    bool "Rotate battery labels for vertical OLED placement"
    depends on ZMK_DONGLE_DISPLAY_BATTERY_ONLY

config ZMK_DONGLE_DISPLAY_VERTICAL_BATTERY_ROTATION
    int "Battery label rotation in 0.1 degree units"
    depends on ZMK_DONGLE_DISPLAY_VERTICAL_BATTERY
    default 2700

config ZMK_DONGLE_DISPLAY_VERTICAL_BATTERY_LEFT_X
    int "X position for the central-side battery label"
    depends on ZMK_DONGLE_DISPLAY_VERTICAL_BATTERY
    default 22

config ZMK_DONGLE_DISPLAY_VERTICAL_BATTERY_RIGHT_X
    int "X position for the peripheral-side battery label"
    depends on ZMK_DONGLE_DISPLAY_VERTICAL_BATTERY
    default 82

config ZMK_DONGLE_DISPLAY_DONGLE_BATTERY
    bool "Show also the battery level of the dongle"
    depends on BT && (!ZMK_SPLIT_BLE || ZMK_SPLIT_ROLE_CENTRAL)

config ZMK_DONGLE_DISPLAY_MAC_MODIFIERS
    bool "Use MacOS modifier symbols instead of the Windows symbols"

config ZMK_DONGLE_DISPLAY_BONGO_CAT
    bool "Display the Bongo Cat widget"
    default y if !ZMK_DONGLE_DISPLAY_BATTERY_ONLY

config ZMK_DONGLE_DISPLAY_MODIFIERS
    bool "Display the modifiers widget"
    default y if !ZMK_DONGLE_DISPLAY_BATTERY_ONLY

config ZMK_DONGLE_DISPLAY_LAYER
    bool "Display the highest layer widget"
    default y if !ZMK_DONGLE_DISPLAY_BATTERY_ONLY

config ZMK_DONGLE_DISPLAY_LAYER_NAME_SCROLL_WIDTH
    int "Width for layer name label (in pixels)"
    default 50
    help
        Width in pixels for the layer name label. When the layer name
        exceeds this width, it will scroll horizontally in a circular pattern.

config ZMK_DONGLE_DISPLAY_LAYER_TEXT_ALIGN
    string "Layer name text alignment"
    default "left"
    help
        Text alignment for the layer name label. Valid values: "left", "center", "right".

config ZMK_DONGLE_DISPLAY_WPM
    bool "Display the WPM widget"
    default n

config ZMK_DONGLE_DISPLAY_WPM_DISABLED_LAYERS
    string "Layers in which the widget is disabled, comma separated"
    default ""

choice ZMK_DISPLAY_WORK_QUEUE
    default ZMK_DISPLAY_WORK_QUEUE_DEDICATED
endchoice

config LV_Z_MEM_POOL_SIZE
    default 4096 if ZMK_DONGLE_DISPLAY_BATTERY_ONLY
    default 8192

config LV_Z_VDB_SIZE
    default 64

config LV_DPI_DEF
    default 148

config LV_Z_BITS_PER_PIXEL
    default 1

choice LV_COLOR_DEPTH
    default LV_COLOR_DEPTH_1
endchoice

endif
```
